## boards/arm/nrf52840dongle_nrf52840/Kconfig.defconfig
```kconfig
# nRF52840 Dongle NRF52840 board configuration
#
# Copyright (c) 2018-2023 Nordic Semiconductor ASA
#
# SPDX-License-Identifier: Apache-2.0

if BOARD_NRF52840DONGLE_NRF52840

config BOARD_NRF52840DONGLE_NRF52840
  select SOC_NRF52840_QIAA

endif # BOARD_NRF52840DONGLE_NRF52840
```

## boards/arm/nrf52840dongle_nrf52840/board.yml
```yaml
board:
  name: nrf52840dongle_nrf52840
  full_name: nRF52840 Dongle
  vendor: nordic
  socs:
  - name: nrf52840
```

## boards/shields/lily58/boards/zhiayang/mikoto/mikoto_nrf52840_zmk_6_1_0_defconfig
```kconfig
CONFIG_BOARD_MIKOTO_CHARGER_CURRENT_100MA=n
CONFIG_BOARD_MIKOTO_CHARGER_CURRENT_40MA=y
```

## config/west.yml
```yaml
manifest:
  remotes:
    - name: HeavyDutySoul
      url-base: https://github.com/HeavyDutySoul
  projects:
    - name: zmk
      remote: HeavyDutySoul
      revision: feat/battery-reporting
      import: app/west.yml
    - name: zmk-soft-off-plus
      remote: HeavyDutySoul
      revision: main
  self:
    path: config
```
