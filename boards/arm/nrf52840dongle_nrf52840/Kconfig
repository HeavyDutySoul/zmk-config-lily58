## boards/arm/nrf52840dongle_nrf52840/Kconfig
```kconfig
# nRF52840 Dongle NRF52840 board configuration

# Copyright (c) 2018-2023 Nordic Semiconductor ASA
# SPDX-License-Identifier: Apache-2.0

if BOARD_NRF52840DONGLE_NRF52840

config BOARD_ENABLE_DCDC
	bool "DCDC mode"
	select SOC_DCDC_NRF52X
	default y

config BOARD_ENABLE_DCDC_HV
	bool "High Voltage DCDC converter"
	select SOC_DCDC_NRF52X_HV
	default y

endif # BOARD_NRF52840DONGLE_NRF52840
```

## boards/shields/lily58/Kconfig.defconfig
```kconfig
if SHIELD_LILY58_DONGLE || SHIELD_LILY58_CENTRAL_LEFT

config ZMK_KEYBOARD_NAME
    default "Lily58"

config ZMK_SPLIT_ROLE_CENTRAL
    default y

endif

if SHIELD_LILY58_DONGLE || SHIELD_LILY58_CENTRAL_LEFT || SHIELD__LILY58_PERIPHERAL_LEFT || SHIELD_LILY58_PERIPHERAL_RIGHT

config ZMK_SPLIT
    default y

endif
```

## boards/shields/lily58/Kconfig.shield
```kconfig
# Copyright (c) 2020 Pete Johanson
# SPDX-License-Identifier: MIT

config SHIELD_LILY58_DONGLE
    def_bool $(shields_list_contains,lily58_dongle)

#config SHIELD_LILY58_LEFT_CENTRAL
#    def_bool $(shields_list_contains,lily58_left_central)

config SHIELD_LILY58_LEFT_PERIPHERAL
    def_bool $(shields_list_contains,lily58_left_peripheral)

config SHIELD_LILY58_RIGHT_PERIPHERAL
    def_bool $(shields_list_contains,lily58_right_peripheral)
```
